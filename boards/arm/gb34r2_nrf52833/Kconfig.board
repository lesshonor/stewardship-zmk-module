## boards/arm/gb34r2_nrf52833/Kconfig.board
```kconfig
# Copyright (c) 2025 The ZMK Contributors
# SPDX-License-Identifier: Apache-2.0

config BOARD_GB34R2_NRF52833
    bool "gb34r2_nrf52833"
    depends on SOC_NRF52833_QIAA
```

## boards/arm/gb34r2_nrf52833/gb34r2_nrf52833_defconfig
```kconfig
# Copyright (c) 2025 The ZMK Contributors
# SPDX-License-Identifier: MIT

CONFIG_SOC_SERIES_NRF52X=y
CONFIG_SOC_NRF52833_QIAA=y
CONFIG_BOARD_GB34R2_NRF52833=y

# Enable MPU
CONFIG_ARM_MPU=y

# Use pinctrl
CONFIG_PINCTRL=y

# enable GPIO
CONFIG_GPIO=y
# required for the shift register
CONFIG_SPI=y

CONFIG_USE_DT_CODE_PARTITION=y
CONFIG_BUILD_OUTPUT_UF2=y
CONFIG_BUILD_OUTPUT_UF2_FAMILY_ID="0x12346688"

CONFIG_MPU_ALLOW_FLASH_WRITE=y
CONFIG_NVS=y
CONFIG_SETTINGS_NVS=y
CONFIG_FLASH=y
CONFIG_FLASH_PAGE_LAYOUT=y
CONFIG_FLASH_MAP=y

# No external crystal
CONFIG_CLOCK_CONTROL_NRF=y
CONFIG_CLOCK_CONTROL_NRF_K32SRC_RC=y

CONFIG_ZMK_USB=y
CONFIG_ZMK_BLE=y
```

## boards/arm/humble40/Kconfig.board
```kconfig
# Copyright (c) 2024 The ZMK Contributors
# SPDX-License-Identifier: Apache-2.0

config BOARD_HUMBLE40
    bool "humble40"
    depends on SOC_RP2040
```

## boards/arm/qaz_rp2040/Kconfig.board
```kconfig
# Copyright (c) 2024 The ZMK Contributors
# SPDX-License-Identifier: Apache-2.0

config BOARD_QAZ_RP2040
	bool "QAZ RP2040"
	depends on SOC_RP2040
```

## boards/arm/qazimodo/Kconfig.board
```kconfig
# Copyright (c) 2025 The ZMK Contributors
# SPDX-License-Identifier: MIT

config BOARD_QAZIMODO
    bool "Qazimodo"
    depends on SOC_STM32F072XB
```

## boards/arm/qazimodo/Kconfig.defconfig
```kconfig
# Copyright (c) 2025 The ZMK Contributors
# SPDX-License-Identifier: MIT

if BOARD_QAZIMODO

config BOARD
    default "qazimodo"

config ZMK_KEYBOARD_NAME
    default "Qazimodo"

endif # BOARD_QAZIMODO
```

## boards/arm/qazimodo/qazimodo_defconfig
```kconfig
### ZEPHYR CONFIG

CONFIG_SOC_SERIES_STM32F0X=y
CONFIG_SOC_STM32F072XB=y

CONFIG_BOARD_QAZIMODO=y

CONFIG_GPIO=y

CONFIG_PINCTRL=y

CONFIG_USB_SELF_POWERED=n

# clock configuration
CONFIG_CLOCK_CONTROL=y
CONFIG_SYS_CLOCK_HW_CYCLES_PER_SEC=48000000

CONFIG_FLASH=y
CONFIG_FLASH_MAP=y
CONFIG_NVS=y

### END ZEPHYR CONFIG

### ZMK SETTINGS

CONFIG_ZMK_KSCAN_MATRIX_POLLING=y
CONFIG_ZMK_USB=y
```

## boards/arm/scallop/Kconfig.board
```kconfig
# Copyright (c) 2024 The ZMK Contributors
# SPDX-License-Identifier: MIT

config BOARD_SCALLOP
    bool "Scallop"
    depends on SOC_NRF52840_QIAA
```

## boards/arm/scallop/Kconfig.defconfig
```kconfig
# Copyright (c) 2024 The ZMK Contributors
# SPDX-License-Identifier: MIT

if BOARD_SCALLOP

config ZMK_KEYBOARD_NAME
    default "Scallop"

config BT_CTLR
    default BT

endif # BOARD_SCALLOP
```

## boards/arm/van/Kconfig.board
```kconfig
# Copyright (c) 2021 Nick Winans
# SPDX-License-Identifier: MIT

config BOARD_VAN
	bool "van"
	depends on SOC_NRF52840_QIAA
```

## boards/eyeohdesigns/humble40/Kconfig.defconfig
```kconfig
# Copyright (c) 2024 The ZMK Contributors
# SPDX-License-Identifier: Apache-2.0

if BOARD_HUMBLE40

config ZMK_KEYBOARD_NAME
    default "humble40"

config RP2_FLASH_W25Q080
    default y

if I2C_DW

config I2C_DW_CLOCK_SPEED
    default 125

endif

config USB_SELF_POWERED
    default n

config ZMK_BACKLIGHT
    default y

if ZMK_BACKLIGHT

config PWM
    default y

config LED
    default y

endif

endif
```

## boards/eyeohdesigns/humble40/Kconfig.humble40
```kconfig
# Copyright (c) 2024 The ZMK Contributors
# SPDX-License-Identifier: Apache-2.0

config BOARD_HUMBLE40
	select SOC_RP2040
```

## boards/niuniu/gb34r2_nrf52833/Kconfig.defconfig
```kconfig
# Copyright (c) 2025 The ZMK Contributors
# SPDX-License-Identifier: Apache-2.0

if BOARD_GB34R2_NRF52833

config ZMK_KEYBOARD_NAME
    default "GB34 r2"

config BT_CTLR
    default BT

endif
```

## boards/quark_works/qaz_rp2040/Kconfig.defconfig
```kconfig
# Copyright (c) 2024 The ZMK Contributors
# SPDX-License-Identifier: Apache-2.0

if BOARD_QAZ_RP2040

config ZMK_KEYBOARD_NAME
    default "QAZ RP2040"

config RP2_FLASH_W25Q080
    default y

if I2C_DW

config I2C_DW_CLOCK_SPEED
    default 125

endif

config USB_SELF_POWERED
    default n

endif
```

## boards/quark_works/qaz_rp2040/Kconfig.qaz_rp2040
```kconfig
# Copyright (c) 2024 The ZMK Contributors
# SPDX-License-Identifier: Apache-2.0

config BOARD_QAZ_RP2040
	select SOC_RP2040
```

## boards/quark_works/qaz_rp2040/qaz_rp2040_defconfig
```kconfig
### ZEPHYR CONFIG

CONFIG_SYS_CLOCK_HW_CYCLES_PER_SEC=125000000
CONFIG_GPIO=y

#CONFIG_CONSOLE=y
#CONFIG_SERIAL=y
#CONFIG_UART_CONSOLE=y
#CONFIG_UART_INTERRUPT_DRIVEN=y

CONFIG_BUILD_OUTPUT_UF2=y
CONFIG_USE_DT_CODE_PARTITION=y

CONFIG_SETTINGS=y
CONFIG_FLASH=y
CONFIG_FLASH_MAP=y
CONFIG_NVS=y

CONFIG_RESET=y

# The RPI Pico MCU could enable this, but I don't know what it does.
#CONFIG_ARM_MPU=y
#CONFIG_MPU_ALLOW_FLASH_WRITE=y

### END ZEPHYR CONFIG

### ZMK CONFIG

CONFIG_ZMK_USB=y

CONFIG_ZMK_RGB_UNDERGLOW_EXT_POWER=n
```

## boards/shields/beatervan/Kconfig.defconfig
```kconfig
if SHIELD_BEATERVAN

config ZMK_KEYBOARD_NAME
    default "Beatervan"

config ZMK_SLEEP
    default y
    depends on SOC_FAMILY_NRF52 #TODO: Keep an eye on this, suspect ZMK proper will institute better guarding when people actually start trying RP2040s

endif
```

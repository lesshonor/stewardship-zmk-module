/*
 * Copyright (c) 2021 Yonatan Schachter
 * Copyright (c) 2024 The ZMK Contributors
 *
 * SPDX-License-Identifier: Apache-2.0
 *
 */

#include <zephyr/dt-bindings/pinctrl/rpi-pico-rp2040-pinctrl.h>

&pinctrl {
    pwm_ch6a_default: pwm_ch6a_default {
        group1 {
            pinmux = <PWM_6A_P28>;
        };
    };
};
